## soc/Kconfig
```kconfig
choice
     prompt "Happy Scrappy Hero Pup SoC Family Selection"

source "$(SOC_DIR)/$(ARCH)/*/Kconfig.soc"

endchoice

menu "Happy Scrappy Hero Pup SoC revision selection"
osource "$(SOC_DIR)/$(ARCH)/*/Kconfig"

endmenu
```

## soc/arm/product/Kconfig
```kconfig
config SOC_FAMILY_HAPPY_SCRAPPY
	bool

if SOC_FAMILY_HAPPY_SCRAPPY
config SOC_FAMILY
	string
	default "happy_scrappy_hero_pup"

config SOC_IS_HAPPY
	bool
	default n

rsource "*/Kconfig.soc"

endif # SOC_FAMILY_HAPPY_SCRAPPY
```

## soc/arm/product/soc_a/Kconfig.defconfig.series
```kconfig
if SOC_SERIES_HAPPY_SCRAPY

config SOC_SERIES
	default "soc_a"

config SOC
	default "yep" if SOC_IS_HAPPY

rsource "Kconfig.defconfig.soc_a_*"

endif # SOC_SERIES_HAPPY_SCRAPPY
```

## soc/arm/product/soc_a/Kconfig.series
```kconfig
config SOC_SERIES_SOC_A
	bool "Happy Scrappy Hero Pup family of SoCs"
	select ARM
	select SOC_FAMILY_HAPPY_SCRAPPY
	select CPU_CORTEX_M3
	select CPU_HAS_ARM_MPU
	select FLASH
	help
	  Enable support for Happy Scrappy

if SOC_SERIES_SOC_A

config HAS_ARM_DIV
	bool "Has support for the ARM divider"
	default y

config ARM_DIV
	int "ARM clock divider value"
	range 0 7

config AHB_DIV
	int "AHB clock divider value"
	range 0 7

config IPG_DIV
	int "IPG clock divider value"
	range 0 3

if SERIAL

config UART_PL011
	default y

config UART_INTERRUPT_DRIVEN
	default y

config UART_PL011_PORT0
	default y

config UART_PL011_PORT1
	default n

endif # SERIAL

endif # SOC_SERIES_SOC_A
```

## soc/arm/product/soc_a/Kconfig.soc
```kconfig
# SOC FAMILY DEFINES
choice
	prompt "Happy Scrapp Hero Pup SOC A"
	depends on SOC_SERIES_SOC_A

config SOC_HAPPY_SCRAPPY_A0
	bool "Steping A0"

endchoice
```

## west.yml
```yaml
manifest:
  remotes:
    - name: github
      url-base: https://github.com

  projects:
    - name: zephyr
      remote: github
      repo-path: zephyrproject-rtos/zephyr
      import: 
        name-whitelist:
          - cmsis
      west-commands: scripts/west-commands.yml
  self:
    path: application
```
